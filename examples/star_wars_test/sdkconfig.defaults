## examples/star_wars_test/sdkconfig.defaults
```kconfig
CONFIG_IDF_TARGET="esp32"
CONFIG_ESPTOOLPY_FLASHSIZE_4MB=y
CONFIG_DAC_DMA_AUTO_16BIT_ALIGN=y
```

## main/Kconfig.projbuild
```kconfig
menu "HTTP audio player"

config AUDIO_WIFI_SSID
    string "Wi-Fi SSID"
    default ""

config AUDIO_WIFI_PASSWORD
    string "Wi-Fi password"
    default ""

config AUDIO_STREAM_URL
    string "HTTP PCM stream URL"
    default "http://192.168.1.100:8000/audio/stream"

config AUDIO_INPUT_URL
    string "Backend audio input URL"
    default "http://192.168.1.100:8000/audio/input"

config AUDIO_DEVICE_TOKEN
    string "Backend device token"
    default ""

config AUDIO_UPLOAD_MAX_BYTES
    int "Maximum phone upload size (bytes)"
    range 1024 52428800
    default 10485760

config AUDIO_UPLOAD_BUFFER_SIZE
    int "Upload proxy buffer size (bytes)"
    range 1024 16384
    default 4096

config AUDIO_UPLOAD_TIMEOUT_MS
    int "Backend upload timeout (ms)"
    range 5000 300000
    default 60000

config AUDIO_WEB_SERVER_PORT
    int "Phone web server port"
    range 1 65534
    default 80

config AUDIO_SAMPLE_RATE
    int "PCM sample rate (Hz)"
    range 8000 48000
    default 16000

config AUDIO_VOLUME_PERCENT
    int "Output volume (%)"
    range 1 100
    default 55

config AUDIO_BUFFER_MS
    int "Audio buffer capacity (ms)"
    range 250 5000
    default 2000

config AUDIO_PREBUFFER_MS
    int "Prebuffer before playback (ms)"
    range 50 2000
    default 250

endmenu
```

## sdkconfig.defaults
```kconfig
CONFIG_IDF_TARGET="esp32"
CONFIG_ESPTOOLPY_FLASHSIZE_4MB=y
CONFIG_ESP_MAIN_TASK_STACK_SIZE=4096
CONFIG_ESP_SYSTEM_EVENT_TASK_STACK_SIZE=3072
CONFIG_ESP_WIFI_STATIC_RX_BUFFER_NUM=8
CONFIG_ESP_WIFI_DYNAMIC_RX_BUFFER_NUM=16
CONFIG_ESP_WIFI_DYNAMIC_TX_BUFFER_NUM=16
CONFIG_DAC_DMA_AUTO_16BIT_ALIGN=y
```
